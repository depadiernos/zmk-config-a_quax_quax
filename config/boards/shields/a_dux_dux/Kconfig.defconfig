## config/boards/shields/a_dux_dux/Kconfig.defconfig
```kconfig
# Copyright (c) 2021 The ZMK Contributors
# SPDX-License-Identifier: MIT

if SHIELD_a_quax_quax_LEFT

config ZMK_KEYBOARD_NAME
	default "Architeuthis Dux Dux"

config ZMK_SPLIT_BLE_ROLE_CENTRAL
	default y

endif

if SHIELD_a_quax_quax_RIGHT

config ZMK_KEYBOARD_NAME
	default "Architeuthis Dux Dux Right"

endif

if SHIELD_a_quax_quax_LEFT || SHIELD_a_quax_quax_RIGHT

config ZMK_SPLIT
	default y

endif
```

## config/boards/shields/a_dux_dux/Kconfig.shield
```kconfig
# Copyright (c) 2021 The ZMK Contributors
# SPDX-License-Identifier: MIT

config SHIELD_A_QUAX_QUAX_LEFT
	def_bool $(shields_list_contains,a_quax_quax_left)

config SHIELD_A_QUAX_QUAX_RIGHT
	def_bool $(shields_list_contains,a_quax_quax_right)
```

## config/boards/shields/a_quax_quax/Kconfig.defconfig
```kconfig
# Copyright (c) 2021 The ZMK Contributors
# SPDX-License-Identifier: MIT

if SHIELD_A_QUAX_QUAX_LEFT

config ZMK_KEYBOARD_NAME
	default "a quax quax"

config ZMK_SPLIT_BLE_ROLE_CENTRAL
	default y

endif

if SHIELD_A_QUAX_QUAX_RIGHT

config ZMK_KEYBOARD_NAME
	default "a quax quax r"

endif

if SHIELD_A_QUAX_QUAX_LEFT || SHIELD_A_QUAX_QUAX_RIGHT

config ZMK_SPLIT
	default y

endif
```
